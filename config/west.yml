## config/west.yml
```yaml
manifest:
  remotes:
    - name: alxcrt
      url-base: https://github.com/alxcrt
    - name: carrefinho # <--- add this for dongle
      url-base: https://github.com/carrefinho # <--- and this dongle
  projects:
    - name: zmk
      remote: alxcrt
      revision: main
      import: app/west.yml

    - name: prospector-zmk-module # <--- and these for dongle
      remote: carrefinho # <---
      revision: main # <---
  self:
    path: config
```
